## arch/mips/mach-econet/Kconfig
```kconfig
menu "Airoha MIPS platforms"
	depends on ARCH_ECONET

config TARGET_EN751221
	bool "Airoha EN751221 SoC"
	select SYSCON
	select MIPS_TUNE_34KC

config TARGET_EN7528
	bool "Airoha EN7528 SoC"
	select SYSCON
	select MIPS_TUNE_1004KC
	select MIPS_SKIP_CP0_COUNT_CLEAR

config SYS_VENDOR
	default "econet"

config SYS_SOC
	default "en751221" if TARGET_EN751221
	default "en7528" if TARGET_EN7528

config SYS_BOARD
	default "en7512" if TARGET_EN751221
	default "en7528" if TARGET_EN7528

config SYS_CONFIG_NAME
	default "en7512" if TARGET_EN751221
	default "en7528" if TARGET_EN7528

config SYS_MALLOC_F_LEN
	default 0x2000

config SYS_DCACHE_SIZE
	default 32768

config SYS_DCACHE_LINE_SIZE
	default 32

config SYS_ICACHE_SIZE
	default 32768

config SYS_ICACHE_LINE_SIZE
	default 32

config TEXT_BASE
	default 0x81000000

config SPL_TEXT_BASE
	default 0x80010000

config SPL_SIZE_LIMIT
	default 0x30000

config TPL_TEXT_BASE
	default 0xbfc00000

config TPL_MAX_SIZE
	default 0x8000


config BUILD_TARGET
	default "u-boot.img" if TARGET_EN751221

config BOARD_EN7512_REFERENCE
	bool "EN7512/EN7521 reference board"
	select TARGET_EN751221
	select BINMAN
	select SPL_LOADER_SUPPORT if SPL
	help
	  Build a boot image compatible with the EN7512/EN7521 TCBoot flow.
	  TPL initializes the serial flash controller, executes the legacy DDR
	  calibration stage from FE SRAM and loads SPL into DDR.

config BOARD_EN7528_TPLINK_XC220_G3V
	bool "TP-Link XC220-G3V (EN7528, chainloaded)"
	select TARGET_EN7528
	help
	  Build U-Boot proper for the TP-Link XC220-G3V. This target assumes a
	  previous boot stage has initialized DDR and the integrated switch PHYs.
	  It intentionally produces a plain u-boot.bin for one-time serial loading,
	  after which Ethernet/TFTP and the 16 MiB SPI-NOR can be used.

config BOARD_EN7528_REFERENCE
	bool "EcoNet EN7528 reference board (DASAN H660GM-A)"
	select TARGET_EN7528
	help
	  Build U-Boot proper for the EcoNet EN7528 reference board, as found
	  on the DASAN H660GM-A.  Like the XC220-G3V it is chainloaded after a
	  previous stage has trained DDR, but boots from SPI-NAND.

endmenu
```

## arch/mips/mach-en75xx/Kconfig
```kconfig
menu "EcoNet/Airoha EN75xx platforms"
	depends on ARCH_EN75XX

config SYS_VENDOR
	default "econet"

config SYS_SOC
	default "en7528" if BOARD_EN7528_TPLINK_XC220_G3V
	default "en7512"

config SYS_BOARD
	default "en7528" if BOARD_EN7528_TPLINK_XC220_G3V
	default "en7512"

config SYS_CONFIG_NAME
	default "en7528" if BOARD_EN7528_TPLINK_XC220_G3V
	default "en7512"

config SYS_MALLOC_F_LEN
	default 0x2000

config EN75XX_SCU
	bool "EcoNet/Airoha EN75xx SCU clock/reset controller"
	default y if BOARD_EN7528_TPLINK_XC220_G3V
	select CLK
	select DM_RESET
	select REGMAP
	select RESET_AIROHA
	help
	  Enable the EN75xx System Control Unit regmap helpers together with
	  the Airoha clock and reset-controller drivers.  EN7528 shares the
	  EN7523 SCU reset layout.

config SYS_DCACHE_SIZE
	default 32768

config SYS_DCACHE_LINE_SIZE
	default 32

config SYS_ICACHE_SIZE
	default 32768

config SYS_ICACHE_LINE_SIZE
	default 32

config TEXT_BASE
	default 0x81000000

config SPL_TEXT_BASE
	default 0x80010000

config SPL_SIZE_LIMIT
	default 0x30000

config TPL_TEXT_BASE
	default 0xbfc00000

config TPL_MAX_SIZE
	default 0x8000


config BUILD_TARGET
	default "u-boot.img" if BOARD_EN7512_REFERENCE

config BOARD_EN7512_REFERENCE
	bool "EN7512/EN7521 reference board"
	select BINMAN
	select SPL_LOADER_SUPPORT if SPL
	help
	  Build a boot image compatible with the EN7512/EN7521 TCBoot flow.
	  TPL initializes the serial flash controller, executes the legacy DDR
	  calibration stage from FE SRAM and loads SPL into DDR.

config BOARD_EN7528_TPLINK_XC220_G3V
	bool "TP-Link XC220-G3V (EN7528, chainloaded)"
	help
	  Build U-Boot proper for the TP-Link XC220-G3V. This target assumes a
	  previous boot stage has initialized DDR and the integrated switch PHYs.
	  It intentionally produces a plain u-boot.bin for one-time serial loading,
	  after which Ethernet/TFTP and the 16 MiB SPI-NOR can be used.

endmenu
```

## configs/en7512_reference_defconfig
```kconfig
CONFIG_MIPS=y
CONFIG_SYS_MALLOC_LEN=0x100000
CONFIG_SPL_LIBCOMMON_SUPPORT=y
CONFIG_SPL_LIBGENERIC_SUPPORT=y
CONFIG_NR_DRAM_BANKS=1
CONFIG_ENV_SIZE=0x1000
CONFIG_DEFAULT_DEVICE_TREE="econet,en7512-reference"
CONFIG_SPL_SYS_MALLOC_F_LEN=0x10000
CONFIG_TPL_SYS_MALLOC_F_LEN=0x1000
CONFIG_SPL_BSS_START_ADDR=0x80080000
CONFIG_SPL_BSS_MAX_SIZE=0x10000
CONFIG_SYS_LOAD_ADDR=0x82000000
CONFIG_SYS_RX_ETH_BUFFER=16
CONFIG_SPL=y
CONFIG_TPL=y
# CONFIG_TPL_FRAMEWORK is not set
CONFIG_ARCH_EN75XX=y
CONFIG_BOARD_EN7512_REFERENCE=y
CONFIG_BOARD_LATE_INIT=y
CONFIG_SYS_MIPS_TIMER_FREQ=150000000
CONFIG_SKIP_LOWLEVEL_INIT=y
CONFIG_MIPS_CACHE_SETUP=y
CONFIG_MIPS_CACHE_DISABLE=y
CONFIG_RESTORE_EXCEPTION_VECTOR_BASE=y
CONFIG_MIPS_BOOT_FDT=y
CONFIG_LEGACY_IMAGE_FORMAT=y
CONFIG_OF_STDOUT_VIA_ALIAS=y
CONFIG_DISPLAY_CPUINFO=y
CONFIG_SPL_MAX_SIZE=0x30000
CONFIG_SPL_SYS_MALLOC_SIMPLE=y
CONFIG_SPL_LEGACY_IMAGE_FORMAT=y
CONFIG_SPL_SERIAL=y
CONFIG_SPL_DM=y
CONFIG_SPL_OF_CONTROL=y
CONFIG_SPL_DM_SERIAL=y
CONFIG_HUSH_PARSER=y
CONFIG_CMD_MEMINFO=y
CONFIG_CMD_MTD=y
CONFIG_CMD_DHCP=y
CONFIG_CMD_PING=y
CONFIG_MTD=y
CONFIG_DM_MTD=y
CONFIG_MTD_SPI_NAND=y
CONFIG_SPI=y
CONFIG_DM_SPI=y
CONFIG_AIROHA_SNFI_SPI=y
CONFIG_ENV_IS_NOWHERE=y
CONFIG_ENV_RELOC_GD_ENV_ADDR=y
CONFIG_NET_RANDOM_ETHADDR=y
CONFIG_AIROHA_ETH=y
# CONFIG_BINMAN_FDT is not set
```
